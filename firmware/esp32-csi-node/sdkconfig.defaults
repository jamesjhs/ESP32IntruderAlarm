## firmware/esp32-csi-node/sdkconfig.defaults
```kconfig
CONFIG_ESP_WIFI_CSI_ENABLED=y
CONFIG_ESP_WIFI_SOFTAP_SUPPORT=y
CONFIG_ESP_WIFI_STA_DISCONNECTED_PM_ENABLE=n
CONFIG_ESP_HTTP_SERVER_ENABLE=y
CONFIG_MBEDTLS_CERTIFICATE_BUNDLE=n
CONFIG_ESP_SYSTEM_EVENT_QUEUE_SIZE=32
```

## firmware/esp32-csi-sender/sdkconfig.defaults
```kconfig
CONFIG_ESP_WIFI_SOFTAP_SUPPORT=y
CONFIG_ESP_WIFI_STA_DISCONNECTED_PM_ENABLE=n
CONFIG_ESPTOOLPY_FLASHSIZE_4MB=y
CONFIG_MBEDTLS_CERTIFICATE_BUNDLE=n
CONFIG_ESP_SYSTEM_EVENT_QUEUE_SIZE=32
```

## firmware/esp32-s3-wroom/sdkconfig.defaults
```kconfig
CONFIG_ESP_WIFI_CSI_ENABLED=y
CONFIG_ESP_WIFI_SOFTAP_SUPPORT=y
CONFIG_ESP_WIFI_STA_DISCONNECTED_PM_ENABLE=n
CONFIG_ESPTOOLPY_FLASHSIZE_8MB=y
CONFIG_MBEDTLS_CERTIFICATE_BUNDLE=n
CONFIG_ESP_SYSTEM_EVENT_QUEUE_SIZE=64
CONFIG_FREERTOS_HZ=1000
```
